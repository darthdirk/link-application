## boards/frekvens/custom_zelda/board.yml
```yaml
# Copyright (c) 2024 Nordic Semiconductor ASA
# SPDX-License-Identifier: Apache-2.0

board:
  name: custom_zelda
  vendor: frekvens
  socs:
    - name: nrf5340
```
